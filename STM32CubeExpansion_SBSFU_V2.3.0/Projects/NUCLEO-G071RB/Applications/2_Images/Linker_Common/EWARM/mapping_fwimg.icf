/*###ICF### Set of symbols used in SE and SB_SFU projects ****/

/* Slots Regions must be aligned on 2048 bytes (0x800) */

/* swap region (8 Kbytes) */
define exported symbol  __ICFEDIT_region_SWAP_start__  = 0x08016000;
define exported symbol  __ICFEDIT_region_SWAP_end__    = 0x08017FFF;

/* slot 0 region (32 Kbytes) */
define exported symbol  __ICFEDIT_region_SLOT_0_start__= 0x0800E000;
define exported symbol  __ICFEDIT_region_SLOT_0_end__  = 0x08015FFF;

/* slot 1 region (32 Kbytes) */
define exported symbol  __ICFEDIT_region_SLOT_1_start__= 0x08018000;
define exported symbol  __ICFEDIT_region_SLOT_1_end__  = 0x0801FFFF;

/* firmware images regions definition */
define region SWAP_region   = mem:[from __ICFEDIT_region_SWAP_start__ to __ICFEDIT_region_SWAP_end__];
define region SLOT_0_region = mem:[from __ICFEDIT_region_SLOT_0_start__ to __ICFEDIT_region_SLOT_0_end__];
define region SLOT_1_region = mem:[from __ICFEDIT_region_SLOT_1_start__ to __ICFEDIT_region_SLOT_1_end__];
