/*###ICF### Set of symbols used in SE and SB_SFU projects ****/

/* Slots Regions must be aligned on 4096 bytes (0x1000) */

/* swap region (4 Kbytes) */
define exported symbol  __ICFEDIT_region_SWAP_start__  = 0x0807E000;
define exported symbol  __ICFEDIT_region_SWAP_end__    = 0x0807EFFF;

/* slot 0 region (220 Kbytes) */
define exported symbol  __ICFEDIT_region_SLOT_0_start__= 0x08010000;
define exported symbol  __ICFEDIT_region_SLOT_0_end__  = 0x08046FFF;

/* slot 1 region (220 KBytes) */
define exported symbol  __ICFEDIT_region_SLOT_1_start__= 0x08047000;
define exported symbol  __ICFEDIT_region_SLOT_1_end__  = 0x0807DFFF;

/* firmware images regions definition */
define region SWAP_region   = mem:[from __ICFEDIT_region_SWAP_start__ to __ICFEDIT_region_SWAP_end__];
define region SLOT_0_region = mem:[from __ICFEDIT_region_SLOT_0_start__ to __ICFEDIT_region_SLOT_0_end__];
define region SLOT_1_region = mem:[from __ICFEDIT_region_SLOT_1_start__ to __ICFEDIT_region_SLOT_1_end__];
