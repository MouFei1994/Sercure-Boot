/*###ICF### Set of symbols used in SE and SB_SFU projects ****/

/* Slots Regions must be aligned on 4096 bytes (0x1000) */

/* slot 0 region (456 Kbytes) */
define exported symbol  __ICFEDIT_region_SLOT_0_start__= 0x0800E000;
define exported symbol  __ICFEDIT_region_SLOT_0_end__  = 0x0807FFFF;

/* firmware images regions definition */
define region SLOT_0_region = mem:[from __ICFEDIT_region_SLOT_0_start__ to __ICFEDIT_region_SLOT_0_end__];
