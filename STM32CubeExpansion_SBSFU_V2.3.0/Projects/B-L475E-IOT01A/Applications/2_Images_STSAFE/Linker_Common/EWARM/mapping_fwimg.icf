/*###ICF### Set of symbols used in SE and SB_SFU projects ****/

/* Slots Regions must be aligned on 2048 bytes (0x800) */

/* swap region (8 kbytes) */
define exported symbol  __ICFEDIT_region_SWAP_start__  = 0x080E0000;
define exported symbol  __ICFEDIT_region_SWAP_end__    = 0x080E1FFF;

/* slot 0 region (320 kbytes) */
define exported symbol  __ICFEDIT_region_SLOT_0_start__= 0x08090000;
define exported symbol  __ICFEDIT_region_SLOT_0_end__  = 0x080DFFFF;

/* slot 1 region (320 kbytes) */
define exported symbol  __ICFEDIT_region_SLOT_1_start__= 0x08026000;
define exported symbol  __ICFEDIT_region_SLOT_1_end__  = 0x08075fff;

/* firmware images regions definition */
define region SWAP_region   = mem:[from __ICFEDIT_region_SWAP_start__ to __ICFEDIT_region_SWAP_end__];
define region SLOT_0_region = mem:[from __ICFEDIT_region_SLOT_0_start__ to __ICFEDIT_region_SLOT_0_end__];
define region SLOT_1_region = mem:[from __ICFEDIT_region_SLOT_1_start__ to __ICFEDIT_region_SLOT_1_end__];