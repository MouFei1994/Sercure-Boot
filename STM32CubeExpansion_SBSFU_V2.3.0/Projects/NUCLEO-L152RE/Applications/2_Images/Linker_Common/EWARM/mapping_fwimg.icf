/*###ICF### Set of symbols used in SE and SB_SFU projects ****/

/* Slots Regions must be aligned on sectors */

/* swap region 4 kbytes */
define exported symbol  __ICFEDIT_region_SWAP_start__ = 0x08070000;
define exported symbol  __ICFEDIT_region_SWAP_end__   = 0x08070FFF;

/* slot 0 region : 192 Kbytes */
define exported symbol  __ICFEDIT_region_SLOT_0_start__=  0x08010000;
define exported symbol  __ICFEDIT_region_SLOT_0_end__  =  0x0803FFFF;

/* slot 1 region : 192 Kbytes */
define exported symbol  __ICFEDIT_region_SLOT_1_start__=  0x08040000;
define exported symbol  __ICFEDIT_region_SLOT_1_end__  =  0x0806FFFF;

/* firmware images regions definition */
define region SWAP_region   = mem:[from __ICFEDIT_region_SWAP_start__ to __ICFEDIT_region_SWAP_end__];
define region SLOT_0_region = mem:[from __ICFEDIT_region_SLOT_0_start__ to __ICFEDIT_region_SLOT_0_end__];
define region SLOT_1_region = mem:[from __ICFEDIT_region_SLOT_1_start__ to __ICFEDIT_region_SLOT_1_end__];
