/*###ICF### Set of symbols used in SE and SB_SFU projects ****/

/* Slots Regions must be aligned on sector size */

/* Swap sector in sector 0 of Bank2 : 16 kbytes */  
define exported symbol  __ICFEDIT_region_SWAP_start__ = 0x08104000; 
define exported symbol  __ICFEDIT_region_SWAP_end__   = 0x08107FFF;

/* Slot 0 in Sector 1 to 7 of Bank1; 976 kbytes */
define exported symbol  __ICFEDIT_region_SLOT_0_start__= 0x08010000;   
define exported symbol  __ICFEDIT_bank1_secure_end__  = 0x080101FF;  /* Secure User Memory: end of the protected area */      
define exported symbol  __ICFEDIT_region_SLOT_0_end__  = 0x08103FFF;

/* Slot 1 in sector 1 to 7 of Bank2 : 976 kbytes */
define exported symbol  __ICFEDIT_region_SLOT_1_start__= 0x08108000;        
define exported symbol  __ICFEDIT_region_SLOT_1_end__  = 0x081FBFFF;

/* firmware images regions definition */
define region SWAP_region   = mem:[from __ICFEDIT_region_SWAP_start__ to __ICFEDIT_region_SWAP_end__];
define region SLOT_0_region = mem:[from __ICFEDIT_region_SLOT_0_start__ to __ICFEDIT_region_SLOT_0_end__];
define region SLOT_1_region = mem:[from __ICFEDIT_region_SLOT_1_start__ to __ICFEDIT_region_SLOT_1_end__];
