/*###ICF### Set of symbols used in SE and SB_SFU projects ****/

/* Slots Regions must be aligned on sector size */

/* Slot 0 : 1984 kbytes */
define exported symbol  __ICFEDIT_region_SLOT_0_start__= 0x08010000; 
define exported symbol  __ICFEDIT_bank1_secure_end__  = 0x080101FF;  /* Secure User Memory: end of the protected area */
define exported symbol  __ICFEDIT_region_SLOT_0_end__ =  0x081FFFFF;

/* firmware images regions definition */
define region SLOT_0_region = mem:[from __ICFEDIT_region_SLOT_0_start__ to __ICFEDIT_region_SLOT_0_end__];
