/*###ICF### Set of symbols used in SE and SB_SFU projects ****/

/*-Specials-*/

/* Slot 0 in Sector 1 to 15 : 15 x 128 kbytes */
define exported symbol  __ICFEDIT_region_SLOT_0_start__= 0x08020000; 
define exported symbol  __ICFEDIT_bank1_secure_end__  = 0x080201FF;  /* Secure User Memory: end of the protected area */
define exported symbol  __ICFEDIT_region_SLOT_0_end__ =  0x081FFFFF;

/* firmware images regions definition */
define region SLOT_0_region = mem:[from __ICFEDIT_region_SLOT_0_start__ to __ICFEDIT_region_SLOT_0_end__];
