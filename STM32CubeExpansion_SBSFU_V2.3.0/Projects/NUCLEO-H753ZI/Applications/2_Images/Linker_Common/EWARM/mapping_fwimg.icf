/*###ICF### Set of symbols used in SE and SB_SFU projects ****/

/* Slots Regions must be aligned on sector size */

/* Swap sector in sector 0 of Bank2 : 128 kbytes */  
define exported symbol  __ICFEDIT_region_SWAP_start__ = 0x08100000; 
define exported symbol  __ICFEDIT_region_SWAP_end__   = 0x0811FFFF;

/* Slot 0 in Sector 1 to 7 of Bank1; 7 x 128 kbytes */
define exported symbol  __ICFEDIT_region_SLOT_0_start__= 0x08020000;   
define exported symbol  __ICFEDIT_bank1_secure_end__  = 0x080201FF;  /* Secure User Memory: end of the protected area */      
define exported symbol  __ICFEDIT_region_SLOT_0_end__  = 0x080FFFFF;

/* Slot 1 in sector 1 to 7 of Bank2 : 7 * 128 kbytes */
define exported symbol  __ICFEDIT_region_SLOT_1_start__= 0x08120000;        
define exported symbol  __ICFEDIT_region_SLOT_1_end__  = 0x081FFFFF;

/* firmware images regions definition */
define region SWAP_region   = mem:[from __ICFEDIT_region_SWAP_start__ to __ICFEDIT_region_SWAP_end__];
define region SLOT_0_region = mem:[from __ICFEDIT_region_SLOT_0_start__ to __ICFEDIT_region_SLOT_0_end__];
define region SLOT_1_region = mem:[from __ICFEDIT_region_SLOT_1_start__ to __ICFEDIT_region_SLOT_1_end__];
